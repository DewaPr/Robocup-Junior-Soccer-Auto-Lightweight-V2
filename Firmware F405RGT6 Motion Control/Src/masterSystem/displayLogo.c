#include "RCJLightWeightMaster.h"
#include "../u8g2/u8g2.h"
#include "main.h"
#include "stdio.h"
#include "stdlib.h"
#include "stdint.h"
#include "math.h"

extern u8g2_t u8g2;

uint8_t logo_width = 128;
uint8_t logo_height = 64;

static const unsigned char logo_bits[] U8X8_PROGMEM  = {
  0x00, 0x00, 0x00, 0x00, 0x00, 0x00, 0x00, 0x00, 0x00, 0x00, 0x00, 0x00,
  0x00, 0x00, 0x00, 0x00, 0x00, 0x00, 0x00, 0x00, 0x00, 0x00, 0x00, 0x00,
  0x00, 0x00, 0x00, 0x00, 0x00, 0x00, 0x00, 0x00, 0x00, 0x00, 0x00, 0x00,
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  0x00, 0x00, 0x00, 0x00,
};

void drawLogo(int _off){
    u8g2_DrawXBMP(&u8g2, 0 , _off, logo_width, logo_height, logo_bits);
    u8g2_SendBuffer(&u8g2);
    u8g2_ClearBuffer(&u8g2);
}

unsigned long logoSlideTime = 0;
int logoSlideOffset = 127;
int logoSlideOffChange = 0;
uint8_t logoSlideAnimation = 0;
void displayLogo(){
  logoSlideOffChange = 0;
  while(1){
    if(HAL_GetTick() - logoSlideTime > ANIMATION_UPDATE_MILLIS){
      logoSlideTime = HAL_GetTick();

      drawLogo(logoSlideOffset);
      if(logoSlideOffset > logoSlideOffChange){
        if(logoSlideAnimation == 0) logoSlideOffset -= ceil(abs(logoSlideOffset - logoSlideOffChange) * ANIMATION_SLIDE_SPEED);
        else {
          logoSlideOffset -= ceil((abs(logoSlideOffset) + 2) * ANIMATION_SLIDE_SPEED);
          // logoSlideOffset -= 2;
          if(logoSlideOffset <= logoSlideOffChange) break;
        }
      }
      if(ceil(logoSlideOffset == 0) && logoSlideAnimation == 0){
        HAL_Delay(500);
        logoSlideOffChange = -127;
        logoSlideAnimation = 1;
      }
    }
  }
}
